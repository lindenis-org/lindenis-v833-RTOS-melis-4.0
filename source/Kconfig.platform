## source/Kconfig.platform
```kconfig
menu "Platform Setup"

choice
	prompt "Chip select"

	config SOC_SUN3IW2P2
		bool "F1C800 AW V1.0 Platform"
		select SOC_SUN3IW2
		help
			Based on F1C800.

	config SOC_SUN3IW2P1
		bool "F1D100 AW V1.0 Platform"
		select SOC_SUN3IW2
		help
			Based on F1D100.

	config SOC_SUN3IW1P1
		bool "F1C200S AW V1.0 Platform"
		select SOC_SUN3IW1
		help
			Based on F1C200S.

	config SOC_SUN8IW18P1
		bool "r328 SOC Platform"
		select SOC_SUN8IW18
		help
			Based on r328 Platform.

	config SOC_SUN8IW19P1
		bool "v833/v831 SOC Platform"
		select SOC_SUN8IW19
		select ARCH_SUN8IW19
		help
			Based on v833/v831 Platform.
endchoice

config SOC_SUN3I
	bool
	default n
	help
		Based on Arm926-ejs SOC familiy.

config SOC_SUN8I
	bool
	default n
	help
		Based on Cortex-A7 SOC familiy.

config SOC_SUN3IW1
	bool
	select SOC_SUN3I
	help
		Based on SUN3IW2 SOC familiy.

config SOC_SUN3IW2
    	bool
	select SOC_SUN3I
    	help
    		Based on SUN3IW2 SOC familiy.

config SOC_SUN8IW18
    	bool
	select SOC_SUN8I
    	help
    		Based on SUN8IW18 SOC familiy.

config ARCH_SUN8IW19
	bool "soc sun8iw19"
	select SOC_SUN8I
	help
		Soc sun8iw19

config SOC_SUN8IW19
	bool
	select SOC_SUN8I
	help
		Based on SUN8IW19 SOC familiy.

config DRAM_PHYBASE
	hex  "Physical base address of Dram"
	default 0x80000000 if SOC_SUN3I
	default 0x40000000 if SOC_SUN8I

config DRAM_VIRTBASE
	hex  "Virtual base address of Dram"
	default 0xc2000000

config DRAM_SIZE
	hex  "Capacity of Dram"
	default 0x04000000
	help
		DDR physical memroy size.

config COHERENT_SIZE
	hex  "Capacity of NoCache Dram Zone"
	default 0x00c00000
	help
		Set Size Of NoCache Dram Zone for DMA etc

config COHERENT_START_ADDR
	hex  "NoCache Dram Zone Start Address"
	default 0xa0000000
	help
		Set Start address of NoCache Dram Zone for DMA etc
endmenu
```

## source/ekernel/core/rt-thread/wrapper/Kconfig
```kconfig
menu "Melis Module Support"

config  MELIS_MODULE
        bool "Support melis module"
        select MELIS_VIRTUAL_FILESYSTEM
        default n

endmenu
```

## source/ekernel/drivers/drv/source/Kconfig
```kconfig
menu "Melis Source Support"

config  DRIVER_SDMMC
        bool "Support SDMMC Driver"
        default n

config  DRIVER_REGULATOR
        bool "Support REGULATOR"
        default n

    source "ekernel/drivers/drv/source/ram_dev/Kconfig"
endmenu
```

## source/ekernel/drivers/hal/source/ccmu/Kconfig
```kconfig
menu "CCMU Devices"

config DRIVERS_CCMU
    bool "enable ccmu driver"
        default y

endmenu
```

## source/ekernel/drivers/hal/source/sdmmc/Kconfig
```kconfig
menu "sdmmc Devices"

config SUNXI_DRIVERS_SDMMC
    bool "enable SUNXI SDMMC device drivers"
        default y

config DETECT_CARD
    bool "enable SUNXI SDMMC detect card"
	depends on SUNXI_DRIVERS_SDMMC
	default y


#menu "SDMMC option freatuers"

endmenu
```

## source/ekernel/drivers/hal/source/usb/gadget/Kconfig
```kconfig
menuconfig DRIVERS_USB_GADGET
	bool "USB Gadget Support"
	depends on DRIVERS_USB_UDC
	help
	  Enable this configuration option if you want to run USB peripheral device.

if DRIVERS_USB_GADGET

config DRIVERS_USB_GADGET_ADB
	bool "ADB Gadget"
	default n
	help
	  Enable adb gadget function

endif #DRIVERS_USB_GADGET
```

## source/ekernel/subsys/Kconfig
```kconfig
menu "Subsystem support"

config CMSIS
    bool "ARM CMSIS interface support"
    default n
    help
       CMSIS enables consistent device support and simple software interfaces to the processor and its peripherals, simplifying software reuse, reducing the learning curve for microcontroller developers, 
       and reducing the time to market for new devices.

config PTHREAD
    bool "Posix Thread Support"
    default n
    help
        Allow pthread_xxx interface to develop application.

config CXX
    bool "CXX Support"
    default n
    help
        Support CXX compile.

config BENCHMARK
    bool "BenchMark Test Support"
    default n
    help
        benchmark test for cpu evolution.

config COMPONENT_ADBD
    bool "Enable Adb support"
    depends on RT_USING_FINSH
    default y

if COMPONENT_ADBD
    config ADBD_AUTOLOAD
        bool "ADB AutoLoad"
        default n
        help
           "support adb autoload when system up"
endif

config DEBUG_BACKTRACE
    bool "Enable Backtrace Support"
    default y

config SUBSYS_ARCHIVAL
    bool "Enable Archival Support"
    default y

config KASAN
    bool "Enable Kasan Support"
    depends on SLAB_DEBUG
    default n

if KASAN
	config KASAN_SHADOW_OFFSET
	hex "kasan shadow offset"
	default 0x54000000

	config KASAN_INLINE
	bool "kasan inline"
	default n

	config KASAN_REPEAT_REPORT_ERROR
	bool "kasan repeat report error"
	default y

endif

menu "Libc library"

    choice
    prompt "C library"
    default LIBCNEWLIB

    config  LIBCNEWLIB
	    bool "newlib "

    config  LIBCNONE
	    bool "none"
    endchoice

config EXTERN_LIBC
    bool
    default n if LIBCNONE
    default y if LIBCNEWLIB
endmenu

source "ekernel/subsys/samples/Kconfig"
source "ekernel/subsys/net/rt-thread/Kconfig"
source "ekernel/subsys/config/Kconfig"
source "ekernel/subsys/thirdparty/Kconfig"
source "ekernel/subsys/aw/Kconfig"
source "ekernel/subsys/env/Kconfig"
source "ekernel/subsys/avframework/Kconfig"
source "ekernel/subsys/finsh_cli/Kconfig"
source "ekernel/subsys/cplusplus/Kconfig"

endmenu
```

## source/ekernel/subsys/aw/Kconfig
```kconfig
menu "Allwinner Components Support"

config SUBSYS_KGDB
    bool "kgdb sutb"
    default n
    help
        The is kgdb stub program, which work as gdbserver.

source "ekernel/subsys/aw/ota/Kconfig"
source "ekernel/subsys/aw/multi_console/Kconfig"
endmenu
```

## source/ekernel/subsys/aw/multi_console/Kconfig
```kconfig
menu "AW Multi-Console Compenents"

config COMPONENTS_MULTI_CONSOLE
    bool "Melis Multi Console"
    default y
    help
        Melis Multi Console Support.
        If unsure, say N.

if COMPONENTS_MULTI_CONSOLE

config MULTI_CONSOLE_DEBUG
    bool "Melis Multi-Console Debug"
    default n
    help
        Melis Multi-Console Debug.

config MULTI_CONSOLE_REDIRECT_CMD
    bool "Melis Multi-Console Redirect Command"
    default n
    help
        Melis Multi-Console Redirece Command.
endif

endmenu
```

## source/ekernel/subsys/finsh_cli/commands/Kconfig
```kconfig
menu "Commands"

    config  COMMAND_FORK
        bool "Fork Command"
        default y

    config  COMMAND_MEM_LAYOUT
        bool "Mem Layout Command"
        default n

    config  COMMAND_DATE
        bool "Date Command"
        default y

    config  COMMAND_EXIT
        bool "Exit Command"
        default y

    config  COMMAND_ADBD
        bool "Adbd Command"
        default y

    config  COMMAND_HELLOWORLD
        bool "helloworld Command"
        default n

    config  COMMAND_RTT_VERSION
        bool "version Command"
        default n

    config  COMMAND_WATCHDOG
        bool "watchdog Command"
        default n

source "ekernel/subsys/finsh_cli/commands/iobox/Kconfig"

endmenu
```
